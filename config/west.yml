## config/west.yml
```yaml
manifest:
  remotes:
    - name: menbou0202
      url-base: https://github.com/menbou0202
    - name: prospector
      url-base: https://github.com/t-ogura

  projects:
    - name: zmk
      remote: menbou0202
      revision: b3544e343c28580a2f5e68c23e83d6f175b8595f
      import: app/west.yml

    - name: prospector-zmk-module
      remote: prospector
      revision: v2.2.3
      path: modules/prospector-zmk-module

  self:
    path: config
```
